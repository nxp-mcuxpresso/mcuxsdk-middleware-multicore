## Kconfig
```kconfig
#
# Copyright 2024 NXP
#
# SPDX-License-Identifier: BSD-3-Clause
#

menu "Multicore SDK"
    orsource "rpmsg-lite/Kconfig"
    orsource "mcmgr/Kconfig"
    orsource "erpc/mcux/Kconfig"
    orsource "remoteproc/Kconfig"
endmenu
```

## remoteproc/Kconfig
```kconfig
#
# Copyright 2024-2025 NXP
#
# SPDX-License-Identifier: BSD-3-Clause
#

menuconfig MCUX_COMPONENT_middleware.multicore.remoteproc
    bool "Multicore Remote Processor Framework"
    help
        This option will enable Multicore Remote Processor Framework

menuconfig MCUX_COMPONENT_middleware.multicore.remoteproc.empty_rsc_table
    bool "Empty resource table of Multicore Remote Processor Framework"
    help
        This option will enable Empty resource table of Multicore Remote Processor Framework
```
